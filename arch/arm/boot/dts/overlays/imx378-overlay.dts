// SPDX-License-Identifier: GPL-2.0-only
// Definitions for IMX378 camera module on VC I2C bus
/dts-v1/;
/plugin/;

#include <dt-bindings/gpio/gpio.h>
#include "imx477_378-overlay.dtsi"

/{
	compatible = "brcm,bcm2835";

	// Fragment numbers deliberately high to avoid conflicts with the
	// included imx477_378 overlay file.

	fragment@101 {
		target = <&imx477>;
		__overlay__ {
			compatible = "sony,imx378";
		};
	};
};
